/*
 * brickOS prototype v0.1.0 — linker script (aarch64 / QEMU virt)
 *
 * Paid off (ADR-0005): the design-side linker script is one of the Platform
 * plugin's outputs (design 4-02 §2 item 4 "physical (binary) layout mapping";
 * the compositor generates linker script fragments).
 * v0.1.0 is handled manually by this file, not generated by `br` — see WORKAROUNDS.md.
 *
 * Address choice: QEMU virt RAM starts at 0x40000000; the kernel traditionally loads
 * at 0x40080000 (512 KiB left for firmware/ATF by convention). This prototype has no
 * firmware dependency, but keep the convention to avoid address trouble when swapping loaders.
 */

OUTPUT_ARCH(aarch64)
OUTPUT_FORMAT(elf64-littleaarch64)
ENTRY(_start)

/*
 * Explicit segments, no "one big RWX segment": without an MMU RWX is harmless,
 * but ELF tools would report `has a LOAD segment with RWX permissions`; and
 * segment permissions are the only way to express "writable" once a loader arrives.
 *   text   : R+X  — code + vector table
 *   rodata : R    — read-only constants
 *   data   : RW   — data + BSS
 */
PHDRS
{
    text   PT_LOAD FLAGS(5);   /* PF_R | PF_X */
    rodata PT_LOAD FLAGS(4);   /* PF_R        */
    data   PT_LOAD FLAGS(6);   /* PF_R | PF_W */
}

SECTIONS
{
    . = 0x40080000;
    __image_start = .;

    /* .text.boot must come first: Platform Entry address = image base */
    .text : ALIGN(16) {
        KEEP(*(.text.boot))
        *(.text.vectors)
        *(.text .text.*)
    } :text
    . = ALIGN(4096);

    .rodata : ALIGN(16) {
        *(.rodata .rodata.*)

        /*
         * extable (fixup table, design 3-02 §10.4): emitted by the `BR_EXTABLE_ENTRY`
         * macro via `.pushsection .br_extable`, collected by the linker — generated at
         * link time, no runtime init (this realizes "extable must be ready before any
         * code that may trigger it"). The '.' means GNU ld makes no __start_/__stop_,
         * so boundary symbols are provided here (as in 3-01 §13.3 for `.br_plugins`).
         */
        . = ALIGN(8);
        __br_extable_start = .;
        KEEP(*(.br_extable))
        __br_extable_stop = .;
    } :rodata

    /*
     * Plugin descriptor section (design 1-01 §13.3 / 3-05 §2.2): objects from
     * `BR_PLUGIN_SECTION` in generated `build/gen/<plugin>/plugin_desc.c` land
     * here; plugin_manager enumerates via `__br_plugins_start/__br_plugins_stop`.
     *
     * None of the three is optional:
     *   - `KEEP`: descriptors have no C referrer (`static const` + `used`), so
     *     `--gc-sections` treats them as garbage — the section must be rooted;
     *   - `ALIGN(8)`: `br_plugin_t` has pointers and `BR_PLUGIN_SECTION`'s
     *     aligned(8) only aligns **within** the section, so start alignment comes
     *     from the linker script (the design's aligned(4) is too weak for pointers);
     *   - **plain assignment** (not PROVIDE): both symbols must always exist and
     *     must not be defined elsewhere — as with `.br_extable`; PROVIDE's
     *     "don't override if defined" semantics are a hazard here.
     *
     * **Only difference** from `.br_extable`: `.br_plugins` gets its own output
     * section (not folded into `.rodata`), for verifiability — `objdump -h` lists
     * only output sections, so folding hides whether/how big the section is; 3-05
     * §2.2 treats `.br_plugins` as a named, bounded section with boundary symbols.
     * It still belongs to `rodata`'s PT_LOAD (R permission, no RWX image).
     */
    .br_plugins : ALIGN(8) {
        __br_plugins_start = .;
        KEEP(*(.br_plugins))
        __br_plugins_stop = .;
    } :rodata
    . = ALIGN(4096);

    .data : ALIGN(16) {
        *(.data .data.*)
    } :data

    /* BSS: start.S zeroes this range; the linker keeps its size a multiple of 8 */
    . = ALIGN(8);
    __bss_start = .;
    .bss : ALIGN(8) {
        *(.bss .bss.*)
        *(COMMON)
    } :data
    . = ALIGN(8);
    __bss_end = .;

    __image_end = .;

    /*
     * Boot stack 64 KiB: reserved by advancing the location counter, **emitting no
     * section content**, so the image file does not grow; RAM is pre-zeroed by QEMU.
     * (A real .stack section would stuff 64 KiB of zeros into the ELF — unnecessary.)
     */
    . = ALIGN(16);
    __stack_bottom = .;
    . += 64 * 1024;
    __stack_top = .;

    /* Compiler/linker noise: not needed in a bare-metal image */
    /DISCARD/ : {
        *(.comment)
        *(.note*)
        *(.eh_frame*)
        *(.ARM.exidx*)
        *(.ARM.attributes)
    }
}
